## user/configs/rockchip_linux_rk3399_defconfig
```kconfig
# =============================================================================
# General setup
# =============================================================================
CONFIG_DEFAULT_HOSTNAME="localhost"
CONFIG_PREEMPT_VOLUNTARY=y

# =============================================================================
# Platform selection
# =============================================================================
CONFIG_ARCH_ROCKCHIP=y

# =============================================================================
# Kernel Features
# =============================================================================
CONFIG_NR_CPUS=8

# =============================================================================
# Boot options
# =============================================================================

# =============================================================================
# Power management options
# =============================================================================
```
